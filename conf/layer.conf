## conf/layer.conf
```bitbake
# We have a conf and classes directory, add to BBPATH
BBPATH := "${BBPATH}:${LAYERDIR}"

# We have a packages directory, add to BBFILES
BBFILES := "${BBFILES} ${LAYERDIR}/packages/*/*.bb \
	${LAYERDIR}/packages/*/*.bbappend"

BBFILE_COLLECTIONS += "panda"
BBFILE_PATTERN_panda := "^${LAYERDIR}/"
BBFILE_PRIORITY_panda = "6"
```

## conf/machine/pandaboard.conf
```bitbake
#@TYPE: Machine
#@NAME: PandaBoard
#@DESCRIPTION: Machine configuration for the http://pandaboard.org/ board
TARGET_ARCH = "arm"
PACKAGE_EXTRA_ARCHS = "armv4 armv4t armv5te armv6 armv7 armv7a"

PREFERRED_PROVIDER_virtual/kernel = "linux-omap4"
PREFERRED_PROVIDER_virtual/xserver = "xserver-kdrive"

XSERVER = "xserver-kdrive-fbdev"
KERNEL_IMAGETYPE = "uImage"

# Only has HDMI connector for external screen
GUI_MACHINE_CLASS = "bigscreen"

# Ship all kernel modules till the board support has matured enough
MACHINE_EXTRA_RRECOMMENDS = " kernel-modules"

include conf/machine/include/tune-cortexa8.inc

IMAGE_FSTYPES += "tar.bz2"
#EXTRA_IMAGECMD_jffs2 = "-lnp "
EXTRA_IMAGEDEPENDS += "u-boot-omap4 x-load-omap4"

SERIAL_CONSOLE = "115200 ttyO2"

UBOOT_ENTRYPOINT = "0x80008000"
UBOOT_LOADADDRESS = "0x80008000"

MACHINE_FEATURES = "kernel26 apm usbgadget usbhost ext3 vfat alsa"
```
